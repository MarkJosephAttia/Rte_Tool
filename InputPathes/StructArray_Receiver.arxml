AUTOSAR XML (schema 4-3-0)
package /Dimmer
  service-sw-component-type:
    service sw component type StructArray_Receiver
      require port StructArray_ReceiverPort: required-com-specs=[Struct_Elem, Array_Elem], required-interface=Service_Interface
      behavior StructArray_Receiver_InternalBehavior
    swc implementation StructArray_Receiver_Implementation: behavior=StructArray_Receiver_InternalBehavior
