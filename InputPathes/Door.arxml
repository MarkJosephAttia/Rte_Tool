AUTOSAR XML (schema 4-3-0)
package /Dimmer
  application sw component type Door
    provide port Door_To_Dimmer_Port: nonqueued-sender-com-spec=Array_Data_Element, provided-interface=Door_Interface
    behavior Door_InternalBehavior
  swc implementation Door_Implementation: behavior=Door_InternalBehavior
