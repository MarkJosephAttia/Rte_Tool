AUTOSAR XML (schema 4-3-0)
package /Dimmer
  application sw component type Light
    require port Light_Port: nonqueued-receiver-com-spec=Dimmer_Status, required-interface=Dimmer_Interface
    behavior Light_InternalBehavior
  swc implementation Light_Implementation: behavior=Light_InternalBehavior
