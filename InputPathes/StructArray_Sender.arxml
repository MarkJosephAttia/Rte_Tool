AUTOSAR XML (schema 4-3-0)
package /Dimmer
  service sw component type StructArray_Sender
    provide port StructArray_SenderPort: provided-com-specs=[Struct_Elem, Array_Elem], provided-interface=Service_Interface
    behavior StructArray_Sender_InternalBehavior
  swc implementation StructArray_Sender_Implementation: behavior=StructArray_Sender_InternalBehavior
