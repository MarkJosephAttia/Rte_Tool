AUTOSAR XML (schema 4-3-0)
standard types defined: boolean, uint8, sint8, uint16, sint16, uint32, sint32, float32
package /Dimmer
  ar-package:
    impl type Struct_1: category=STRUCTURE
      element Int: category=Value, base-type=sint8
      element Bool: category=Value, base-type=boolean
package /Dimmer/ImplementationDataTypes
  impl type Value_1: category=VALUE, base-type=sint8
package /Dimmer/ImplementationDataTypes
  impl type Array_1: category=ARRAY
    element Element: category=Value, array-size=10, array-size-semantics=FIXED-SIZE, base-type=uint8
package /Dimmer/PortInterfaces
  sender receiver interface Door_Interface
    data Array_Data_Element: type=Array_1
  sender receiver interface Light_Interface
    data Struct_Data_Element: type=Struct_1
  client server interface Client_Server_Interface
    operation Op1
      arg arg1: type=Struct_1, direction=output
      arg arg2: type=Array_1, direction=input
      arg arg3: type=Value_1, direction=input
