AUTOSAR XML (schema 4-3-0)
standard types defined: boolean, uint8, sint8, uint16, sint16, uint32, sint32
package /Dimmer
  ar-package:
    impl type Struct_t: category=STRUCTURE
      element Element_1: category=Value, base-type=uint8
      element Element_2: category=Value, base-type=boolean
package /Dimmer/ImplementationDataTypes
  impl type DoorStatus_t: category=VALUE, base-type=boolean
  impl type DimmerStatus_t: category=VALUE, implementation-data-type=DoorStatus_t
  impl type SwitchState_t: category=VALUE, implementation-data-type=DoorStatus_t
package /Dimmer/ImplementationDataTypes
  impl type Array_t: category=ARRAY
    element Element: category=Value, array-size=5, array-size-semantics=FIXED-SIZE, implementation-data-type=DoorStatus_t
package /Dimmer/PortInterfaces
  5 x sender receiver interface:
    DoorInterface
      data DoorStatus: type=DoorStatus_t
    DoorContact_Interface
      data DoorContact_Status: type=DoorStatus_t
    Dimmer_Interface
      data Dimmer_Status: type=DimmerStatus_t
    StructArray_Interface
      data Struct_Element: type=Struct_t
    Service_Interface
      data Struct_Elem: type=Struct_t
      data Array_Elem: type=Array_t
  client server interface Switch_State
    operation getSwitchState
      arg SwitchState: type=SwitchState_t, direction=output
